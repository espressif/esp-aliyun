## Kconfig
```kconfig
menu "iotkit embedded"

config HAL_SEM_MAX_COUNT
    int "The maximum count value that can be reached of the semaphore"
    default 255
    range 0 255
    help
        The recommended value of maximum count of the semaphore is 255

config HAL_SEM_INIT_COUNT
    int "The count value assigned to the semaphore when it is created"
    default 0
    range 0 10
    help
        The recommended value of count of the semaphore is 0
config HAL_TLS_HANDSHAKE_TIMEOUT
    int "TLS Handsake Timeout"
    default 180
    range 0 65535
    help
        Default TLS handshake timeout to host in seconds

endmenu
```

## examples/awss/sdkconfig.defaults
```kconfig
CONFIG_NEWLIB_LIBRARY_LEVEL_NORMAL=y

CONFIG_ENABLE_PTHREAD=y

CONFIG_SSL_USING_WOLFSSL=y
```

## examples/mqtt/main/Kconfig.projbuild
```kconfig
menu "Demo Configuration"

config WIFI_SSID
    string "WiFi SSID"
	default "********"
	help
		SSID (network name) to connect to.

config WIFI_PASSWORD
    string "WiFi Password"
	default "1234567890"
	help
		WiFi password (WPA or WPA2) to use.

		Can be left blank if the network has no security set.

config PRODUCT_KEY
    string "product key"
	default ""
	help
		fetch it from aliyun console.

config DEVICE_NAME
    string "device name"
	default ""
	help
		fetch it from aliyun console.

config DEVICE_SECRET
    string "device secret"
	default ""
	help
		fetch it from aliyun console.

endmenu
```

## examples/mqtt/mqtt_example/main/Kconfig.projbuild
```kconfig
menu "Example Configuration"

config WIFI_SSID
    string "WiFi SSID"
	default "myssid"
	help
		SSID (network name) for the example to connect to.

config WIFI_PASSWORD
    string "WiFi Password"
	default "myssid"
	help
		WiFi password (WPA or WPA2) for the example to use.

		Can be left blank if the network has no security set.

config LINKKIT_KEY_ENABLE_CONFIG
    bool "Enable configuration linkit key"
    default n
        help
        Whether to enable menuconfig to configure quads

menu "aliyun linkkit key"
depends on LINKKIT_KEY_ENABLE_CONFIG
config LINKKIT_PRODUCT_KEY
    string "product key"
    default "xxxx"
    help
       aliyun linkkit product key.

config LINKKIT_PRODUCT_SECRET
    string "product secret"
    default "xxxx"
    help
       aliyun linkkit product secret.

config LINKKIT_DEVICE_NAME
    string "device name"
    default "xxxx"
    help
        aliyun linkkit device name.

config LINKKIT_DEVICE_SECRET
    string "device secret"
    default "xxxx"
    help
        aliyun linkkit device secret.
endmenu

endmenu
```

## examples/mqtt/sdkconfig.defaults
```kconfig
# ignore make warning
CONFIG_MAKE_WARN_UNDEFINED_VARIABLES=

# newlib for ESP32 and ESP8266 platform

CONFIG_NEWLIB_ENABLE=y
CONFIG_NEWLIB_LIBRARY_LEVEL_NORMAL=y
CONFIG_NEWLIB_NANO_FORMAT=
```

## examples/ota/ota_example_mqtt/sdkconfig.defaults
```kconfig
# Default sdkconfig parameters to use the OTA
# partition table layout, with a 4MB flash size
CONFIG_ESPTOOLPY_FLASHSIZE_4MB=y
CONFIG_PARTITION_TABLE_TWO_OTA=y

CONFIG_NEWLIB_LIBRARY_LEVEL_NORMAL=y
CONFIG_ENABLE_PTHREAD=y
CONFIG_SSL_USING_WOLFSSL=y

#
# Aliyun IOT SDK
#
CONFIG_ALIYUN_IOT_SDK=y
CONFIG_ALIYUN_FIRMWARE_VERSION="0.0.1"

#
# Aliyun device key
#
CONFIG_ALIYUN_PRODUCT_KEY="xxxx"
CONFIG_ALIYUN_PRODUCT_SECRET="xxxx"
CONFIG_ALIYUN_DEVICE_NAME="xxxx"
CONFIG_ALIYUN_DEVICE_SECRET="xxxx"

#
# Aliyun awss config
#
CONFIG_ALIYUN_AWSS_TIMEOUT_INTERVAL_MS=180000
CONFIG_ALIYUN_AWSS_CHANNELSCAN_INTERVAL_MS=200

#
# Aliyun netwoek config
#
CONFIG_ALIYUN_TCP_ESTABLISH_TIMEOUT_MS=10000
CONFIG_ALIYUN_TLS_ESTABLISH_TIMEOUT_MS=10000
CONFIG_ALIYUN_TLS_HANDSHAKE_TIMEOUT=180

#
# Aliyun hal config
#
CONFIG_ALIYUN_HAL_SEM_MAX_COUNT=255
CONFIG_ALIYUN_HAL_SEM_INIT_COUNT=0
```

## examples/ota_example_mqtt/sdkconfig.defaults
```kconfig
# Default sdkconfig parameters to use the OTA
# partition table layout, with a 4MB flash size
CONFIG_ESPTOOLPY_FLASHSIZE_4MB=y
CONFIG_PARTITION_TABLE_TWO_OTA=y

CONFIG_NEWLIB_LIBRARY_LEVEL_NORMAL=y
CONFIG_ENABLE_PTHREAD=y
CONFIG_SSL_USING_WOLFSSL=y
```

## examples/solo/example_solo/components/linkkit_handle/Kconfig
```kconfig
menu "iotkit solo"
    config SUPPORT_RAW_DATA
        bool "Support raw data transfere"
        default n
        help
            Select this option to enable raw data transfere
endmenu
```

## examples/solo/example_solo/sdkconfig.defaults
```kconfig
CONFIG_ESPTOOLPY_BAUD_921600B=y
CONFIG_AWSS_CHANNELSCAN_INTERVAL_MS=100
CONFIG_SNTP_RETRY_TIMEOUT=500
CONFIG_SNTP_RETRY_MAX=20
CONFIG_LWIP_DHCP_MAX_NTP_SERVERS=3
CONFIG_AWSS_TIMEOUT_INTERVAL_MS=60000
CONFIG_TIMER_TASK_STACK_DEPTH=3072
CONFIG_TCP_SYNMAXRTX=3
```

## examples/solutions/smart_light/sdkconfig.defaults
```kconfig
CONFIG_NEWLIB_LIBRARY_LEVEL_NORMAL=y

CONFIG_ENABLE_PTHREAD=y

CONFIG_SSL_USING_WOLFSSL=y

CONFIG_ESPTOOLPY_BAUD_921600B=y
CONFIG_ESPTOOLPY_BAUD=921600

CONFIG_ESPTOOLPY_FLASHSIZE_4MB=y
CONFIG_PARTITION_TABLE_TWO_OTA=y
```

## examples/subdev/sdkconfig.defaults
```kconfig
# ignore make warning
CONFIG_MAKE_WARN_UNDEFINED_VARIABLES=

# newlib for ESP32 and ESP8266 platform

CONFIG_NEWLIB_ENABLE=y
CONFIG_NEWLIB_LIBRARY_LEVEL_NORMAL=y
CONFIG_NEWLIB_NANO_FORMAT=

# disable lwip multithread for RTOS
CONFIG_LWIP_SOCKET_MULTITHREAD=
```
